## CMakeLists.txt
```
cmake_minimum_required(VERSION 3.20.0)
find_package(Zephyr REQUIRED HINTS $ENV{ZEPHYR_BASE})

project(SENSONEO_FINAL_PROJECT)

# manually add path to include or other used folders
target_include_directories(app PRIVATE include)

# manually add source files
target_sources(app PRIVATE
src/main.c
src/sensoneo_gpio.c
src/sensoneo_timers.c
src/sensoneo_state_machine.c
src/sensoneo_bluetooth.c
)
```

## prj.conf
```kconfig
# config file is used to enable/disable features in the kernel
CONFIG_GPIO=y # used for GPIO
CONFIG_SMF=y # used for state machine
CONFIG_BT=y # used for bluetooth
CONFIG_BT_DEVICE_NAME="nRF52_dev_board_samuel" # name of the bluetooth device
```

## src/main.c
```c
/*
All file structures, naming overall organization does not follow any known standard.
However the structure is as simple and easy to understand as possible.

Whole project contains sometimes more documentation and comments as needed.
 */



#include <zephyr/kernel.h>
#include "sensoneo_gpio.h"
#include "sensoneo_timers.h"
#include "sensoneo_state_machine.h"
#include "sensoneo_bluetooth.h"

//#define PRINT_DEBUG // Print debug messages, all debug messages are printed with printk in main loop
#define SLEEP_TIME 250 // Sleep time in while loop


int main(void)
{
        // setup all gpios, tasks, timers, state machines, etc.
        sensoneo_gpio_setup(); // setup all GPIO pins (Buttons, Leds, basic I/O)
        sensoneo_timers_setup(); // setup all timers
        sensoneo_led_state_machine_setup(); // setup state machine

        // Initiate all tasks and timers, state machines, etc.
        sensoneo_run_timers(); // start all timers

        // start bluetooth
        sensoneo_initiate_bluetooth();

        while(true){
                #ifdef PRINT_DEBUG
                        printk("-----------------------\n");
                        printk("Alternating leds period: %i\n", alternating_leds_interval_ms);
                #endif

                // the state run will be later added to separate thread, for now i will leave it in while loop
                smf_run_state(SMF_CTX(&led_state_machine_handler)); // run current state
        }

        return 0; // Code should never reach this point
}
```

## include/sensoneo_bluetooth.h
```c
#ifndef SENSONEO_BLUETOOTH_H
#define SENSONEO_BLUETOOTH_H

#include <zephyr/types.h>
#include <stddef.h>
#include <zephyr/sys/printk.h>
#include <zephyr/sys/util.h>

// bluetooth libs
#include <zephyr/bluetooth/bluetooth.h>
#include <zephyr/bluetooth/hci.h>

// device name defined in prj.conf
#define DEVICE_NAME CONFIG_BT_DEVICE_NAME
#define DEVICE_NAME_LEN (sizeof(DEVICE_NAME) - 1)

static const struct bt_data ad[] = {
	BT_DATA_BYTES(BT_DATA_FLAGS, BT_LE_AD_NO_BREDR),
	BT_DATA_BYTES(BT_DATA_UUID16_ALL, 0xaa, 0xfe),
	BT_DATA_BYTES(BT_DATA_SVC_DATA16,
		      0xaa, 0xfe, /* Eddystone UUID */
		      0x10, /* Eddystone-URL frame type */
		      0x00, /* Calibrated Tx power at 0m */
		      0x00, /* URL Scheme Prefix http://www. */
		      'A', 'e', 'p', 'h', 'y', 'r',
		      'p', 'r', 'o', 'j', 'e', 'c', 't',
		      0x08) /* .org */
};

/* Set Scan Response data */
static const struct bt_data sd[] = {
	BT_DATA(BT_DATA_NAME_COMPLETE, DEVICE_NAME, DEVICE_NAME_LEN),
};



#endif // SENSONEO_BLUETOOTH_H
```

## include/sensoneo_gpio.h
```c
#ifndef SENSONEO_GPIO_H
#define SENSONEO_GPIO_H

// INCLUDES
/*
Zephyr includes are needed for overall functionality, the kernel will be included basically in every file.
Is that OK? IDK but it works.

Libraries that are needed are a mystery, I just use them when following a tutorial so I don't know what they do
and if there is a simpler way to do stuff.
*/
#include <zephyr/kernel.h>
#include <zephyr/device.h>
#include <zephyr/devicetree.h>
#include <zephyr/drivers/gpio.h>  // <- SOME DRIVERS MUST BE ENABLED IN prj.conf

// We will control some timers values
#include "sensoneo_timers.h"



/*
These defines are questionable IMO, I feel like there might later be problem with backwards compatibility if someone
changes device tree. However, getting nodes by alias is probably a good practice but we MUST keep the aliases as
simple and exact as possible. I dont agree with the initial project aliases led0, led1, sw0, sw1 so I will
change them to my liking. (_ and capitals are not allowed in aliases)

FOR SOME REASON top-left-led CANNOT BE USED. I DONT KNOW WHY SO FOR NOW WE HAVE TO GO WITH THE UGLY led0 ALIASES
# FIXME: Check why top-left-led cannot be used as an alias

Use DT_ALIAS to get a node by its alias, there are other options such as DT_NODELABEL, DT_PATH, DT_PATH_OR_NONE,...
*/
// Get nodes of LEDS
# define TOP_LEFT_LED_NODE          DT_ALIAS(led0)
# define TOP_RIGHT_LED_NODE         DT_ALIAS(led1)
# define BOTTOM_LEFT_LED_NODE          DT_ALIAS(led2)
# define BOTTOM_RIGHT_LED_NODE         DT_ALIAS(led3)

// Get nodes of BUTTONS
# define TOP_LEFT_BUTTON_NODE       DT_ALIAS(btn0)
# define TOP_RIGHT_BUTTON_NODE      DT_ALIAS(btn1)

// PUBLIC FUNCTIONS

void sensoneo_gpio_setup(void);
void alternating_leds_timer_callback(void);
void set_leds(uint8_t led_mask);


#endif // GPIO_SETUP_H
```

## include/sensoneo_state_machine.h
```c
#ifndef SENSONEO_STATE_MACHINE_H
#define SENSONEO_STATE_MACHINE_H

// Check GPIO header for details
#include <zephyr/kernel.h>
#include <zephyr/device.h>
#include <zephyr/devicetree.h>
#include <zephyr/smf.h>

#include "sensoneo_gpio.h"

static const struct smf_state state_machine_states_list[4]; // stores all states of any state machine

// define state machine states <- this is not used anywhere so idk if it is needed
enum led_state_machine_states{
    NO_LEDS,
    ONE_LED,
    BOTH_LEDS,
    LAST_LED
};

// create state machine object
extern struct s_object{
    struct smf_ctx ctx;
}led_state_machine_handler;

// Public function
void sensoneo_led_state_machine_setup(void);

#endif
```

## include/sensoneo_timers.h
```c
#ifndef SENSONEO_TIMERS_H
#define SENSONEO_TIMERS_H

// Check GPIO header for details
#include <zephyr/kernel.h>
#include <zephyr/device.h>
#include <zephyr/devicetree.h>

// timers are tied to our own libraries also
#include "sensoneo_gpio.h"

extern uint16_t alternating_leds_interval_ms; // so we can print the value in main loop

void sensoneo_timers_setup(void);
void sensoneo_run_timers(void);
void increase_alternating_leds_interval(void);
void decrease_alternating_leds_interval(void);

#endif
```

## src/sensoneo_bluetooth.c
```c
#include "sensoneo_bluetooth.h"

static void bt_ready(int err);

void sensoneo_initiate_bluetooth(void){
    int err;
    err = bt_enable(bt_ready);
	if (err) {
		printk("Bluetooth init failed (err %d)\n", err);
	}
	return 0;
}

static void bt_ready(int err)
{
	char addr_s[BT_ADDR_LE_STR_LEN];
	bt_addr_le_t addr = {0};
	size_t count = 1;

	if (err) {
		printk("Bluetooth init failed (err %d)\n", err);
		return;
	}
	printk("Bluetooth initialized\n");

	/* Start advertising */
	err = bt_le_adv_start(BT_LE_ADV_NCONN_IDENTITY, ad, ARRAY_SIZE(ad),
			      sd, ARRAY_SIZE(sd));
	if (err) {
		printk("Advertising failed to start (err %d)\n", err);
		return;
	}


	/* For connectable advertising you would use
	 * bt_le_oob_get_local().  For non-connectable non-identity
	 * advertising an non-resolvable private address is used;
	 * there is no API to retrieve that.
	 */

	bt_id_get(&addr, &count);
	bt_addr_le_to_str(&addr, addr_s, sizeof(addr_s));

	printk("Beacon started, advertising as %s\n", addr_s);
}
```

## src/sensoneo_gpio.c
```c
#include "sensoneo_gpio.h"

// Private functions

static void gpio_configurations();
static void blink_leds(uint8_t num_of_blinks, uint8_t interval_ms);
static void button_pressed_callback(const struct device *dev, struct gpio_callback *cb, uint32_t pins);

/*
All "devices" have their own structures that keep their state and configuration.
I don't have an insight to these structures, I just use them as they are in the tutorials and docs.
*/

// I believe it's a good idea to keep all handlers in one place, so I will not define these structs as extern
// LEDS
static const struct gpio_dt_spec top_left_led = GPIO_DT_SPEC_GET(TOP_LEFT_LED_NODE, gpios);
static const struct gpio_dt_spec top_right_led = GPIO_DT_SPEC_GET(TOP_RIGHT_LED_NODE, gpios);
static const struct gpio_dt_spec bottom_left_led = GPIO_DT_SPEC_GET(BOTTOM_LEFT_LED_NODE, gpios);
static const struct gpio_dt_spec bottom_right_led = GPIO_DT_SPEC_GET(BOTTOM_RIGHT_LED_NODE, gpios);

// BUTTONS
static const struct gpio_dt_spec top_left_button = GPIO_DT_SPEC_GET(TOP_LEFT_BUTTON_NODE, gpios);
static const struct gpio_dt_spec top_right_button = GPIO_DT_SPEC_GET(TOP_RIGHT_BUTTON_NODE, gpios);

// GPIO buttons are tied to interrupts, so we need to define interrupt handlers
static struct gpio_callback top_left_button_callback;
static struct gpio_callback top_right_button_callback;


/**
 * @brief Sets up the GPIO configurations and interrupt handlers for Sensoneo.
 *
 * This function initializes the GPIO configurations for input and output. It also ties the interrupt handlers to the buttons
 * and configures the interrupts to be triggered on button press. Finally, it blinks the LEDs to indicate the end of GPIO setup.
 */
void sensoneo_gpio_setup(void){
    gpio_configurations();  // setup INPUT, OUTPUT

    // Tie the interrupt handlers to the buttons
    // First we have to initiate the callback with target function and target pins (probably could be done with one trace back)
	gpio_init_callback(&top_left_button_callback, button_pressed_callback, BIT(top_left_button.pin));
	gpio_init_callback(&top_right_button_callback, button_pressed_callback, BIT(top_right_button.pin));
    // assign the callback to the buttons
	gpio_add_callback(top_left_button.port, &top_left_button_callback);
	gpio_add_callback(top_right_button.port, &top_right_button_callback);
    // configure the interrupts to be triggered on button press
	gpio_pin_interrupt_configure_dt(&top_left_button, GPIO_INT_EDGE_TO_ACTIVE);
	gpio_pin_interrupt_configure_dt(&top_right_button, GPIO_INT_EDGE_TO_ACTIVE);

    blink_leds(5, 100); // Blink leds to end GPIO setup, one will keep on
    return;
}

/**
 * @brief Callback function for alternating LEDs.
 *
 * This function is called by a timer to toggle the state of two LEDs.
 * It toggles the state of the top left LED and the top right LED.
 */
void alternating_leds_timer_callback(void){
    gpio_pin_toggle_dt(&top_left_led);
    gpio_pin_toggle_dt(&top_right_led);
}


/////////////////// STATIC FUNCTIONS ///////////////////////

/**
 * @brief Construct a new gpio pin configure dt object
 *
 * @brief Configures the GPIO settings.
 *
 * This function is responsible for configuring the GPIO settings.
 * It is a static function and does not return any value.
 *
 * The setup parameters are INPUT, OUTPUT values and some other parameters?
 */
static void gpio_configurations(){
    // LEDS
    // Configure the LED pins as output
    gpio_pin_configure_dt(&top_left_led, GPIO_OUTPUT);
    gpio_pin_configure_dt(&top_right_led, GPIO_OUTPUT);
    gpio_pin_configure_dt(&bottom_left_led, GPIO_OUTPUT);
    gpio_pin_configure_dt(&bottom_right_led, GPIO_OUTPUT);

    // BUTTONS
    // Configure the BUTTON pins as input
    gpio_pin_configure_dt(&top_left_button, GPIO_INPUT); // Copilot wants to import some more parameters (DEBOUNCE, ...)
    // gpio_pin_configure_dt(&top_left_button, GPIO_INPUT, GPIO_ACTIVE_HIGH | GPIO_PULL_UP | GPIO_INT_DEBOUNCE);
    gpio_pin_configure_dt(&top_right_button, GPIO_INPUT);
    return;
}

/**
 * @brief Blinks the LEDs for a specified number of times with a given interval.
 *
 * This function blinks the top left and top right LEDs for a specified number of times
 * with a given interval between blinks.
 *
 * @param num_of_blinks The number of times to blink the LEDs.
 * @param interval_ms The interval between each blink in milliseconds.
 */
static void blink_leds(uint8_t num_of_blinks, uint8_t interval_ms){
    for(uint8_t i = 0; i < num_of_blinks; i++){
        gpio_pin_set_dt(&top_left_led, 1);
        gpio_pin_set_dt(&top_right_led, 1);
        gpio_pin_set_dt(&bottom_left_led, 1);
        gpio_pin_set_dt(&bottom_right_led, 1);
        k_msleep(interval_ms);
        gpio_pin_set_dt(&top_left_led, 0);
        gpio_pin_set_dt(&top_right_led, 0);
        gpio_pin_set_dt(&bottom_left_led, 0);
        gpio_pin_set_dt(&bottom_right_led, 0);
        k_msleep(interval_ms);
    }
    gpio_pin_set_dt(&top_left_led, 1);
    return;
}

/**
 * @brief Callback function for button press event.
 *
 * This function is called when a button is pressed. It checks which button was pressed
 * and performs the corresponding action. It prevents scrolling through speeds too fast
 * by using a flag to track if the button is being held.
 *
 * @param dev The device structure for the GPIO device.
 * @param cb The callback structure for the GPIO callback.
 * @param pins The bitmask of pins that triggered the callback.
 */
static void button_pressed_callback(
    const struct device *dev,
    struct gpio_callback *cb,
    uint32_t pins)
{
    bool button_held = false; // to prevent holding button and scrolling though speeds too fast

    if (gpio_pin_get_dt(&top_left_button)) {
        if (!button_held) {
            increase_alternating_leds_interval();
            button_held = true;
        }
    } else if (gpio_pin_get_dt(&top_right_button)) {
        if (!button_held) {
            decrease_alternating_leds_interval();
            button_held = true;
        }
    } else {
        button_held = false;
    }
    printk("Alternating leds period: %i\n", alternating_leds_interval_ms);
}



/**
 * Sets the state of LEDs based on the given LED mask.
 *
 * The leds are controlled by each bit in a uin8_t variable.
 * Since first two leds are used by buttons, we will use the bottom two leds.
 *
 * @param led_mask The LED mask indicating which LEDs to turn on.
 *                 Bit 0 controls the bottom right LED.
 *                 Bit 1 controls the bottom left LED.
 *
 */
void set_leds(uint8_t led_mask){
    gpio_pin_set_dt(&bottom_right_led, (led_mask & 0x01));
    gpio_pin_set_dt(&bottom_left_led, (led_mask & 0x02));
}
```

## src/sensoneo_state_machine.c
```c
#include "sensoneo_state_machine.h"

// private functions
static void no_leds(void *o);
static void one_led(void *o);
static void both_leds(void *o);
static void last_led(void *o);

struct s_object led_state_machine_handler; // use the extern handler (from header)


// create the state machine by defining all states and their functions
// this can be used by multiple state machines !!!
static const struct smf_state state_machine_states_list[4] = {
    [NO_LEDS] = SMF_CREATE_STATE(NULL, no_leds, NULL, NULL, NULL), // entry, run and exit functions for each state
    [ONE_LED] = SMF_CREATE_STATE(NULL, one_led, NULL, NULL, NULL), // entry, run and exit functions for each state
    [BOTH_LEDS] = SMF_CREATE_STATE(NULL, both_leds, NULL, NULL, NULL), // entry, run and exit functions for each state
    [LAST_LED] = SMF_CREATE_STATE(NULL, last_led, NULL, NULL, NULL) // entry, run and exit functions for each state
};


/**
 * @brief Sets up the Sensoneo LED state machine.
 *
 * This function creates the state machine and initializes it with the initial state.
 *
 * @param None
 * @return None
 */
void sensoneo_led_state_machine_setup(void){
    // create the state machine
    smf_set_initial(SMF_CTX(&led_state_machine_handler), &state_machine_states_list[NO_LEDS]); // initialize the state machine
}

/**
 * @brief Turns off all LEDs, sleeps for 500ms, and changes the state of the state machine.
 *
 * This function turns off all LEDs by calling the `set_leds` function with the argument `0b00`.
 * It then sleeps for 500 milliseconds using the `k_msleep` function.
 * Finally, it changes the state of the state machine by calling the `smf_set_state` function with the next state as an argument.
 *
 * @param o A pointer to the object.
 */
static void no_leds(void *o){
    // turn off all leds
    set_leds(0b00);
    k_msleep(500); // sleep for 500ms

    // change state
    smf_set_state(SMF_CTX(&led_state_machine_handler), &state_machine_states_list[ONE_LED]); // set the next state
}

/**
 *
 * @brief Turns on/off all LEDs, sleeps for 500ms, and changes the state of the state machine.
 *
 * This works basiccaly the same as the \ref no_leds function, but it turns on only one LED.
 */
static void one_led(void *o){
    // turn off all leds
    set_leds(0b10);
    k_msleep(500); // sleep for 500ms

    // change state
    smf_set_state(SMF_CTX(&led_state_machine_handler), &state_machine_states_list[BOTH_LEDS]); // set the next state
}

/**
 *
 * @brief Turns on/off all LEDs, sleeps for 500ms, and changes the state of the state machine.
 *
 * This works basiccaly the same as the \ref no_leds function, but it turns on only one LED.
 */
static void both_leds(void *o){
    // turn off all leds
    set_leds(0b11);
    k_msleep(500); // sleep for 500ms

    // change state
    smf_set_state(SMF_CTX(&led_state_machine_handler), &state_machine_states_list[LAST_LED]); // set the next state
}

/**
 *
 * @brief Turns on/off all LEDs, sleeps for 500ms, and changes the state of the state machine.
 *
 * This works basiccaly the same as the \ref no_leds function, but it turns on only one LED.
 */
static void last_led(void *o){
    // turn off all leds
    set_leds(0b01);
    k_msleep(500); // sleep for 500ms

    // change state
    smf_set_state(SMF_CTX(&led_state_machine_handler), &state_machine_states_list[NO_LEDS]); // set the next state
}
```

## src/sensoneo_timers.c
```c
#include "sensoneo_timers.h"

struct k_timer alternating_leds_timer;
extern uint16_t alternating_leds_interval_ms = 500; // 500ms default value

/**
 * @brief Initializes the Sensoneo timers.
 */
void sensoneo_timers_setup(void){
    // Setup the timers
    k_timer_init(&alternating_leds_timer, alternating_leds_timer_callback, NULL); // NULL -> Stop function (not used now)
    return;
}

/**
 * @brief Starts running the Sensoneo timers.
 *
 * This must be called after init function
 */
void sensoneo_run_timers(void){
    k_timer_start(&alternating_leds_timer, K_MSEC(500), K_MSEC(alternating_leds_interval_ms)); // timer, initial delay, period
    return;
}

/**
 * @brief Increases the interval of the alternating LEDs timer.
 */
void increase_alternating_leds_interval(void){
    if(alternating_leds_interval_ms < 1000){
        alternating_leds_interval_ms += 100;
    }
    k_timer_start(&alternating_leds_timer, K_MSEC(500), K_MSEC(alternating_leds_interval_ms)); // timer, initial delay, period
    return;
}

/**
 * @brief Decreases the interval of the alternating LEDs timer.
 */
void decrease_alternating_leds_interval(void){
    if(alternating_leds_interval_ms > 100){
        alternating_leds_interval_ms -= 100;
        k_timer_start(&alternating_leds_timer, K_MSEC(500), K_MSEC(alternating_leds_interval_ms)); // timer, initial delay, period
    }
    return;
}
```
